
#include "gcn_model.h"
#include <Arduino.h>

const float GNN_W1[4][34] = {0.515082, -1.066648, -1.174592, -1.092407, 1.048254, 1.448834, 1.336190, -0.888753, -0.763806, -0.025314, 1.353646, -1.294147, -1.299758,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 1.418692, -0.722193};

const float GNN_B1[4] = {0.652131, 0.487316, 0.739693, 0.656608};

const float GNN_W2[4][4] = {-1.486195, -0.993028, -2.042904, 2.001334, -0.304879, -0.758951, 1.890871, 0.435756, -1.286637, -1.058994, -1.433853, -2.394762, 2.160633, 2.265789, -0.832625, -1.289802};

const float GNN_B2[4] = {-0.525121, -1.623733, 1.954911, -1.789752};

const float GNN_ADJ[34][34] = {1.000000, 1.000000, 1.000000, 1.000000, 1.000000, 1.000000, 1.000000, 1.000000, 1.000000, 0.000000, 1.000000, 1.000000, 1.000000,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 1.000000, 1.000000};


const float GNN_REAL_X[34][34] = {1.000000, 0.000000, 0.000000, 0.000000, 0.000000, 0.000000, 0.000000, 0.000000, 0.000000, 0.000000, 0.000000, 0.000000, 0.000000,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 0.000000, 1.000000};

const int GNN_REAL_Y[34] = {1, 1, 1, 1, 3, 3, 3, 1, 0, 1, 3, 1, 1, 1, 0, 0, 3, 1, 0, 1, 0, 1, 0, 0, 2, 2, 0, 0, 2, 0, 0, 2, 0, 0};


float relu(float x) { return (x > 0) ? x : 0; }

void gnn_layer(const float* X, int in_dim, const float* W, const float* B, int out_dim, float* Output) {
    float linear_temp[NUM_NODES][HIDDEN_DIM > OUT_CLASSES ? HIDDEN_DIM : OUT_CLASSES];

    // Linear Transformation
    for(int i=0; i<NUM_NODES; i++) {
        for(int j=0; j<out_dim; j++) {
            float sum = 0;
            for(int k=0; k<in_dim; k++) {
                sum += X[i*in_dim + k] * W[j*in_dim + k];
            }
            linear_temp[i][j] = sum + B[j];
        }
    }

    // Aggregation
    for(int i=0; i<NUM_NODES; i++) {
        for(int j=0; j<out_dim; j++) {
            float sum = 0;
            for(int k=0; k<NUM_NODES; k++) {
                if(GNN_ADJ[i][k] > 0) {
                    sum += GNN_ADJ[i][k] * linear_temp[k][j];
                }
            }
            Output[i*out_dim + j] = sum;
        }
    }
}

void gnn_predict(const float input_features[NUM_NODES][IN_FEATURES], int output_classes[NUM_NODES]) {
    static float h1[NUM_NODES][HIDDEN_DIM];
    gnn_layer((const float*)input_features, IN_FEATURES, (const float*)GNN_W1, GNN_B1, HIDDEN_DIM, (float*)h1);
    
    for(int i=0; i<NUM_NODES; i++) 
        for(int j=0; j<HIDDEN_DIM; j++) 
            h1[i][j] = relu(h1[i][j]);

    static float h2[NUM_NODES][OUT_CLASSES];
    gnn_layer((const float*)h1, HIDDEN_DIM, (const float*)GNN_W2, GNN_B2, OUT_CLASSES, (float*)h2);

    for(int i=0; i<NUM_NODES; i++) {
        int best = 0;
        float max_val = h2[i][0];
        for(int c=1; c<OUT_CLASSES; c++) {
            if(h2[i][c] > max_val) {
                max_val = h2[i][c];
                best = c;
            }
        }
        output_classes[i] = best;
    }
}
